## tools/lvglbench/v8/sdkconfig.defaults
```kconfig
CONFIG_ESPTOOLPY_FLASHSIZE_16MB=y
CONFIG_ESPTOOLPY_FLASHMODE_QIO=y
CONFIG_PARTITION_TABLE_SINGLE_APP_LARGE=y
CONFIG_ESP_DEFAULT_CPU_FREQ_MHZ_240=y
CONFIG_SPIRAM=y
CONFIG_SPIRAM_MODE_OCT=y
CONFIG_SPIRAM_SPEED_80M=y
CONFIG_FREERTOS_HZ=1000
CONFIG_COMPILER_OPTIMIZATION_PERF=y
CONFIG_ESP_TASK_WDT_EN=n
CONFIG_LV_COLOR_DEPTH_16=y
CONFIG_LV_USE_TINY_TTF=y
CONFIG_LV_FONT_MONTSERRAT_14=y
CONFIG_LV_BUILD_EXAMPLES=n
# LVGL 8: heap from malloc (as v9 below), 16-bit colour without byte swap (the app swaps in its flush)
CONFIG_LV_MEM_CUSTOM=y
CONFIG_LV_COLOR_16_SWAP=n
CONFIG_LV_DISP_DEF_REFR_PERIOD=15
CONFIG_LV_FONT_MONTSERRAT_20=y
CONFIG_LV_FONT_MONTSERRAT_28=y
CONFIG_LV_FONT_MONTSERRAT_48=y
```

## tools/lvglbench/v96os/sdkconfig.defaults
```kconfig
CONFIG_ESPTOOLPY_FLASHSIZE_16MB=y
CONFIG_ESPTOOLPY_FLASHMODE_QIO=y
CONFIG_PARTITION_TABLE_SINGLE_APP_LARGE=y
CONFIG_ESP_DEFAULT_CPU_FREQ_MHZ_240=y
CONFIG_SPIRAM=y
CONFIG_SPIRAM_MODE_OCT=y
CONFIG_SPIRAM_SPEED_80M=y
CONFIG_FREERTOS_HZ=1000
CONFIG_COMPILER_OPTIMIZATION_PERF=y
CONFIG_ESP_TASK_WDT_EN=n
CONFIG_LV_COLOR_DEPTH_16=y
CONFIG_LV_USE_TINY_TTF=y
CONFIG_LV_FONT_MONTSERRAT_14=y
CONFIG_LV_BUILD_EXAMPLES=n
# LVGL 9: heap from malloc (as v8 above)
CONFIG_LV_USE_CLIB_MALLOC=y
CONFIG_LV_DEF_REFR_PERIOD=15
CONFIG_LV_THEME_DEFAULT_TRANSITION_TIME=0
CONFIG_LV_FONT_MONTSERRAT_20=y
CONFIG_LV_FONT_MONTSERRAT_28=y
CONFIG_LV_FONT_MONTSERRAT_48=y
CONFIG_LV_USE_CLIB_STRING=y
CONFIG_LV_USE_CLIB_SPRINTF=y
# Two software draw units (LVGL draws on both cores): needs LVGL's FreeRTOS mode
CONFIG_LV_OS_FREERTOS=y
CONFIG_LV_DRAW_SW_DRAW_UNIT_CNT=2
```
